## meta-hdsc/conf/layer.conf
```bitbake
# We have a conf and classes directory, add to BBPATH
BBPATH .= ":${LAYERDIR}"

# We have recipes-* directories, add to BBFILES
BBFILES += "${LAYERDIR}/meta-common/recipes-*/*/*.bb \
            ${LAYERDIR}/meta-common/recipes-*/*/*.bbappend"

BBFILE_COLLECTIONS += "hdsc"
BBFILE_PATTERN_hdsc = ""
LAYERVERSION_hdsc = "1"

# Provide a variable that points the base of the hdsc layer.
HDSCBASE = '${@os.path.normpath("${LAYERDIR}/")}'
```

## meta-hdsc/meta-hs9216/conf/layer.conf
```bitbake
# We have a conf and classes directory, add to BBPATH
BBPATH .= ":${LAYERDIR}"

# We have recipes-* directories, add to BBFILES
BBFILES += "${LAYERDIR}/recipes-*/*/*.bb \
            ${LAYERDIR}/recipes-*/*/*.bbappend"

BBFILE_COLLECTIONS += "hs9216"
BBFILE_PATTERN_hs9216 = ""
BBFILE_PRIORITY_hs9216 = "5"
```

## meta-hdsc/meta-hs9216/conf/machine/hs9216.conf
```bitbake
KMACHINE = "aspeed"
KERNEL_DEVICETREE = "${KMACHINE}-bmc-hyve-${MACHINE}.dtb"

require conf/machine/include/ast2500.inc
require conf/machine/include/obmc-bsp-common.inc

UBOOT_MACHINE = "ast_g5_phy_config"

FLASH_SIZE = "32768"


OBMC_MACHINE_FEATURES += "\
        obmc-phosphor-fan-mgmt \
        obmc-phosphor-chassis-mgmt \
        obmc-phosphor-flash-mgmt \
        obmc-host-ipmi \
        obmc-host-ctl \
        obmc-host-state-mgmt \
        obmc-chassis-state-mgmt \
        obmc-bmc-state-mgmt \
        "


VIRTUAL-RUNTIME_skeleton_workbook = "${MACHINE}-config"

PREFERRED_PROVIDER_virtual/obmc-host-ipmi-hw ?= "phosphor-ipmi-kcs"

#Hyve use "packagegroup-mct-apps" to provide the obmc-* config


PREFERRED_PROVIDER_virtual/obmc-chassis-mgmt = "packagegroup-hs9216-apps"
#PREFERRED_PROVIDER_virtual/obmc-fan-mgmt = "packagegroup-hs9216-apps"
PREFERRED_PROVIDER_virtual/obmc-flash-mgmt = "packagegroup-hs9216-apps"
PREFERRED_PROVIDER_virtual/obmc-system-mgmt = "packagegroup-hs9216-apps"
PREFERRED_PROVIDER_virtual/obmc-inventory-data ?= "${VIRTUAL-RUNTIME_skeleton_workbook}"

PREFERRED_PROVIDER_virtual/obmc-gpio-monitor = "phosphor-gpio-monitor"
```
